## drivers/gpu/msm/Kconfig
```kconfig
config QCOM_KGSL
	tristate "Qualcomm Technologies, Inc. 3D Graphics driver"
	default n
	depends on ARCH_QCOM
	select GENERIC_ALLOCATOR
	select FW_LOADER
	select PM_DEVFREQ
	select DEVFREQ_GOV_SIMPLE_ONDEMAND
	select DEVFREQ_GOV_PERFORMANCE
	select DEVFREQ_GOV_QCOM_ADRENO_TZ
	select DEVFREQ_GOV_QCOM_GPUBW_MON
	---help---
	  3D graphics driver for the Adreno family of GPUs from QTI.
	  Required to use hardware accelerated OpenGL, compute and Vulkan
	  on QTI targets. This includes power management, memory management,
	  and scheduling for the Adreno GPUs.

config QCOM_ADRENO_DEFAULT_GOVERNOR
	string "devfreq governor for the adreno core"
	default "msm-adreno-tz" if DEVFREQ_GOV_QCOM_ADRENO_TZ
	default "simple_ondemand"
	depends on QCOM_KGSL

config QCOM_KGSL_IOMMU
	bool
	default y if QCOM_KGSL && (MSM_IOMMU || ARM_SMMU)

config CORESIGHT_ADRENO
	bool
	default y if QCOM_KGSL=y && CORESIGHT=y

config ADRENO_GPU_OVERCLOCK
	bool "Overclock Adreno 640 GPU to 757 MHz"
	depends on QCOM_KGSL
	default n
	help
	  Raises the maximum GPU frequency of the Adreno 640 from
	  675 MHz to 757 MHz. This requires adequate cooling and may
	  reduce battery life. Use at your own risk.

config ADRENO_GPU_OVERCLOCK_835
	bool "Overclock Adreno 640 GPU to 835 MHz (extreme)"
	depends on ADRENO_GPU_OVERCLOCK
	default n
	help
	  Raises the maximum GPU frequency of the Adreno 640 from
	  675 MHz to 835 MHz. This is an extreme overclock that
	  significantly increases power consumption and heat output.
	  Not recommended for daily use. Implies ADRENO_GPU_OVERCLOCK.
```

## security/baseband-guard/Kconfig
```kconfig
config BBG
	bool "Enable Baseband Guard (Anti-Format)"
	default y
	depends on SECURITY
	help
	  An Android baseband anti-formatting protector module by Github
	  @showdo / vc-teahouse, preventing malicious scripts or programs
	  from writing into important partitions (modem/baseband, boot chain).
	  If unsure, leave this y.

config BBG_DEBUG
	bool "Baseband Guard debug messages"
	depends on BBG
	default n
	help
	  Enable pr_debug logging in baseband guard.

config BBG_BLOCK_BOOT
	bool "Enable Baseband Protection for Boot Partition"
	depends on BBG
	default n
	help
	  Enable protection for boot partition to prevent malicious scripts
	  or programs destroying, however this may cause failure when flashing
	  kernels in Android system (meaning that you'll only be able to flash
	  kernels/boot partition image in recovery/fastboot mode).
	  If unsure, leave this n.

config BBG_BLOCK_RECOVERY
	bool "Enable Baseband Protection for Recovery Partition"
	depends on BBG
	default n
	help
	  Enable protection for recovery partition to prevent malicious scripts
	  or programs destroying, however this may cause failure when flashing
	  custom recs in Android system (meaning that you'll only be able to
	  flash recovery partition image in fastbootd/bootloader mode).
	  If unsure, leave this n.
```
